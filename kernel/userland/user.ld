/* ユーザープログラムのリンクスクリプト（S9-b-1）。
 *
 * 非 PIE の ET_EXEC を 0x400000 へリンクする。0x400000 は Linux の非 PIE の
 * 既定と同じで、「コストがゼロの範囲で Linux に寄せる」に当たる。
 *
 * .text.prepad を .text._start より前に置く。entry と最初の PT_LOAD の先頭を
 * 一致させないためである（理由は hello.rs のコメント）。 */

ENTRY(_start)

/* プログラムを置く先頭。 */
USER_LOAD_ADDR = 0x400000;

/* 受け皿（`ud2`）を entry から何バイト目に置くか。
 *
 * **期待した終わり方が起きなかったときに実行が落ちる先である**（S9-b-3-2a）。
 * 位置が決まっていると、そこへ落ちたことが RIP で分かる。
 *
 * **以前は各プログラムの `.org` で固定していた。** その形だと、値が
 * アセンブリと Rust の 2 か所にあり、**検算を足してコードが伸びるたびに
 * 両方を直すことになる**（S10-b で 3 度起きた。0x100 → 0x200 → 0x400 → 0x800）。
 * **ここを唯一の出所にすると、直す場所が 1 つになる。**
 *
 * **収まらなくなったときに静かには通らない性質は残る**——`.text` がこの位置を
 * 越えると、リンカが節の重なりとして落ちる。
 *
 * **S11-10 で 0x800 から 0x1000 へ上げた。** `syscall-test` の `.text` が
 * 0x85C になり、実際にリンカが落ちた（S10-b の 3 度に続く 4 度目である）。
 *
 * **1 ページちょうどにした。** 中途半端な値にすると、次に越えたときにまた
 * 少しだけ上げることになる。**`.rodata` はどのみち `ALIGN(4096)` で次のページから
 * 始まるので、ページ境界に合わせておけば、受け皿は `.text` と同じ最後のページに
 * 入る。**
 *
 * **代償は詰め物である。** `.text` の末尾から受け皿までがゼロで埋まり、
 * **像に載る。** そのぶん最初の `PT_LOAD` が 1 ページから 2 ページになり、
 * **会計の判定行がプログラムごとに 1 枚ずつ増える。**
 *
 * **拡張の系列は S12 前の手当ての 2 本目で終わった。** 下の `MAX` を見ること。
 * **5 度目が来たときに、上げるのをやめた。** 経緯は次のとおりである。
 *
 * **`sh` に固定の既定（`/` を含まない語を `/bin/` の下で探す）を入れたところ
 * `.text` が 0x109E になって落ちた。** 上げる形（0x1000 -> 0x2000）を試したが、
 * **起動が止まった**——`spawn-test` の `.text` は 0x8B しかないので、
 * **詰め物が 4096 バイトを丸ごと覆うゼロのブロックになり、`mke2fs` がそこを
 * 穴として格納した。** ZaytOS の ext2 は穴を拒む（S10-a）ので、
 * **`spawn` が像を読む前に落ちる。**
 *
 * **元のファイルを非スパースにしても直らない。** 実測した——ホスト上で穴の無い
 * ファイルを `mke2fs -d` に渡しても、**`mke2fs` 自身がゼロのブロックを検出して
 * 穴にする。**
 *
 * **そして、上限そのものが 5 本にとって無意味だった。**
 * **受け皿を持つのは `syscall-test` と `spawn-test` の 2 本だけである**
 * （`.section .userland.receiver` を宣言しているのがその 2 本。`userlib.rs` にも
 * 「持たない」と書いてある）。**残る 5 本は、下の代入が位置カウンタを動かす
 * 巻き添えで縛られていた**——**移す対象を持たない側が、移動のために止められて
 * いた。** */
USER_RECEIVER_OFFSET = 0x1000;

SECTIONS
{
  . = USER_LOAD_ADDR;

  .text : {
    /* KEEP が要る。詰め物は entry から到達できないので、リンカのセクション
     * 回収（--gc-sections）が落とす。実際に落ちて entry が 0x400000 のままに
     * なった。 */
    KEEP(*(.text.prepad))
    *(.text._start)
    *(.text .text.*)
  }

  /* 受け皿を置く。**リンカに置かせるので、プログラム側の `.org` は要らない。**
   *
   * `.text` と同じ権限（r-x）なので、同じ PT_LOAD に入る。間の隙間は
   * リンカが埋める。**このセクションを持たないプログラムでは何も起きない。**
   *
   * **名前を `.text.receiver` にしない。** 上の `*(.text .text.*)` が先に
   * 拾ってしまい、ここへは何も残らない（**出力セクションは先に書いたほうが
   * 勝つ**）。
   *
   * **`MAX` である（S12 前の手当ての 2 本目）。** 以前はここが無条件の代入で、
   * **`.text` がこの位置を越えると位置カウンタが後ろへ戻り、リンカが
   * `.rodata` との重なりとして落ちた。** エラーが受け皿ではなく `.rodata` を
   * 指していたのはそのためである。
   *
   * **`MAX` にすると、越えた側は縛られない。**
   *
   * - **収まるプログラム**——`MAX` が固定の位置を選ぶので、**配置は 1 バイトも
   *   変わらない。** 受け皿は固定の位置に置かれ続ける
   * - **越えるプログラム**——`MAX` が `.text` の末尾を選ぶので、
   *   位置カウンタが後ろへ戻らない。`.rodata` は次のページ境界から始まる
   *
   * **`MAX` は rust-lld が解釈する**（実測。4200 バイトの `.text` を持つ
   * 試験用のプログラムがこの形で通った）。 */
  . = MAX(., USER_LOAD_ADDR + USER_RECEIVER_OFFSET);
  .userland.receiver : { KEEP(*(.userland.receiver)) }

  /* **受け皿が動いていないことを要求する。**
   *
   * **`MAX` は、上の上限が消える代わりに 1 つ静かに壊れる道を開ける**——
   * **受け皿を持つプログラムの `.text` が越えると、受け皿が黙って後ろへ動く。**
   * **受け皿の値打ちは位置が決まっていることなので、動いては意味が無い**
   * （そこへ落ちたことを RIP で示すためにある）。**上限はその副産物である。**
   *
   * **持たないプログラムは `SIZEOF` が 0 なので素通りする。**
   *
   * **越えると落ちることを実測した**（受け皿を持ち `.text` が 4200 バイトの
   * 試験用のプログラムで、この文言がそのまま出た）。
   *
   * **代償が 1 つある。80 バイトである。** `ADDR` と `SIZEOF` がこの節を指すので、
   * **持たないプログラムでも空の節が像に現れる**（節ヘッダ 64 バイトと、
   * `.shstrtab` の中の名前）。**実測で `hello` が 8496 から 8576 バイトになった。**
   * **`PT_LOAD` の数は変わらない**（空なのでセグメントにならない）。 */
  ASSERT(SIZEOF(.userland.receiver) == 0 ||
         ADDR(.userland.receiver) == USER_LOAD_ADDR + USER_RECEIVER_OFFSET,
         "the receiver moved: .text outgrew USER_RECEIVER_OFFSET")

  /* 各 PT_LOAD をページ境界から始める。
   *
   * 揃えないと、権限の違う 2 つの PT_LOAD が同じ 4KiB ページに載る。
   * 実測でそうなった（.text が 0x400000..0x400030、.rodata が 0x400030 から）。
   * 1 枚のページに 2 つの権限は載らないので、ローダーは後から来たほうを
   * 張れない。**実際のツールチェインも同じ理由でセグメントを揃える。** */
  . = ALIGN(4096);
  .rodata : { *(.rodata .rodata.*) }

  . = ALIGN(4096);
  .data   : { *(.data .data.*) }
  .bss    : { *(.bss .bss.*) *(COMMON) }

  /DISCARD/ : { *(.comment) *(.note.*) *(.eh_frame*) }
}
